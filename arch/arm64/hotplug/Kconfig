## arch/arm64/hotplug/Kconfig
```kconfig
menu "Custom Hotplug drivers"

config CUSTOM_HOTPLUG
	bool "Enable custom hotplug support"
 
config ALUCARD_CONTROL
	bool "Alucard"
	depends on CUSTOM_HOTPLUG
	help
	  Known for being battery friendly. Developed by Alucard_24@XDA
     
endmenu
```
